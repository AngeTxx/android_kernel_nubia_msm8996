## Kconfig
```kconfig
#
# For a description of the syntax of this configuration file,
# see Documentation/kbuild/kconfig-language.txt.
#
mainmenu "Linux/$ARCH $KERNELVERSION Kernel Configuration"

config SRCARCH
	string
	option env="SRCARCH"

config THE_FUCKING_NUBIA
	bool "The Fucking Nubia"
	help
	  Nubia hacked these things but they didn't add any ifdefs

source "arch/$SRCARCH/Kconfig"
```
